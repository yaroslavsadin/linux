/*
 * Copyright (C) 2013 Synopsys, Inc. (www.synopsys.com)
 *
 * ARC AXS101 S/W development platform
 *
 * This program is free software; you can redistribute it and/or modify
 * it under the terms of the GNU General Public License version 2 as
 * published by the Free Software Foundation.
 */
/dts-v1/;

/include/ "axc003_arc700.dtsi"
/include/ "axs10x_mb.dtsi"

/ {
	compatible = "snps,axs103_arc700", "snps,arc-sdp";

	chosen {
		/*
		 * There're 2 instances of "console":
		 *   1) console=tty0 - this one for LCD display over HDMI
		 *   2) console=ttyS3,115200n8 - this is for serial port
		 *
		 * Both consoles will output full boot log as well as
		 * kernel messages.
		 * But in most cases only ttyS3 will be used for spawning
		 * terminal with shell. If terminal with shell is required on
		 * tty0 (read LCD screen + USB-keyboard) please make sure
		 * inittab sets up both ttys accordingly.
		 */
		bootargs = "earlycon=uart8250,mmio32,0xe0022000,115200n8 console=tty0 console=ttyS3,115200n8 debug print-fatal-signals=1";
	};
};
