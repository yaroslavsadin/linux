/*
 * Copyright (C) 2013 Synopsys, Inc. (www.synopsys.com)
 *
 * ARC Xplorer System 770D/EM6/AS221
 *
 * This program is free software; you can redistribute it and/or modify
 * it under the terms of the GNU General Public License version 2 as
 * published by the Free Software Foundation.
 */
/dts-v1/;

/include/ "xplorer_cputile_770.dtsi"
/include/ "xplorer_fpga.dtsi"

/ {
	compatible = "snps,xplorer770";

	chosen {
		bootargs = "console=ttyS3,115200n8";
	};
};
