## arch/metag/Kconfig
```kconfig
config SYMBOL_PREFIX
	string
	default "_"

config METAG
	def_bool y
	select EMBEDDED
	select HAVE_64BIT_ALIGNED_STRUCT
	select HAVE_MEMBLOCK
	select HAVE_MEMBLOCK_NODE_MAP
	select HAVE_OPROFILE
	select HAVE_FUNCTION_TRACER
	select HAVE_FUNCTION_TRACE_MCOUNT_TEST
	select HAVE_DYNAMIC_FTRACE
	select HAVE_FTRACE_MCOUNT_RECORD
	select HAVE_ARCH_TRACEHOOK
	select HAVE_PERF_EVENTS
	select HAVE_IRQ_WORK
	select HAVE_KERNEL_GZIP
	select HAVE_KERNEL_BZIP2
	select HAVE_KERNEL_LZMA
	select HAVE_KERNEL_XZ
	select HAVE_KERNEL_LZO
	select HAVE_SYSCALL_TRACEPOINTS
	select HAVE_GENERIC_HARDIRQS
	select HAVE_DEBUG_KMEMLEAK
	select GENERIC_ATOMIC64
	select GENERIC_CLOCKEVENTS
	select GENERIC_IRQ_SHOW
	select GENERIC_SMP_IDLE_THREAD
	select IRQ_DOMAIN
	select OF
	select OF_EARLY_FLATTREE
	help
	  Imagination Technologies Meta processors are a family of multi-
	  threaded DSPs designed for embedded systems.

config STACKTRACE_SUPPORT
	def_bool y

config LOCKDEP_SUPPORT
	def_bool y

config HAVE_LATENCYTOP_SUPPORT
	def_bool y

config RWSEM_GENERIC_SPINLOCK
	def_bool y

config RWSEM_XCHGADD_ALGORITHM
	bool

config GENERIC_HWEIGHT
	def_bool y

config IRQ_PER_CPU
	def_bool y

config GENERIC_CALIBRATE_DELAY
	def_bool y

config GENERIC_GPIO
	def_bool n

config NO_IOPORT
	def_bool y

source "init/Kconfig"

source "kernel/Kconfig.freezer"

menu "Processor type and features"

config MMU
	def_bool y

config STACK_GROWSUP
	def_bool y

config HOTPLUG_CPU
	bool "Enable CPU hotplug support"
	depends on SMP && HOTPLUG
	help
	  Say Y here to allow turning CPUs off and on. CPUs can be
	  controlled through /sys/devices/system/cpu.

	  Say N if you want to disable CPU hotplug.

config HIGHMEM
	bool "High Memory Support"
	depends on MMU
	help
	  The address space of Meta processors is only 4 Gigabytes large
	  and it has to accommodate user address space, kernel address
	  space as well as some memory mapped IO. That means that, if you
	  have a large amount of physical memory and/or IO, not all of the
	  memory can be "permanently mapped" by the kernel. The physical
	  memory that is not permanently mapped is called "high memory".

	  Depending on the selected kernel/user memory split, minimum
	  vmalloc space and actual amount of RAM, you may not need this
	  option which should result in a slightly faster kernel.

	  If unsure, say n.

source "arch/metag/mm/Kconfig"

source "arch/metag/Kconfig.soc"

config META12
	bool
	---help---
	  Select this from the SoC config symbol to indicate that it contains a
	  Meta 1.2 core.

config META21
	bool
	---help---
	  Select this from the SoC config symbol to indicate that it contains a
	  Meta 2.1 core.

config SMP
	bool "Symmetric multi-processing support"
	depends on META21
	select USE_GENERIC_SMP_HELPERS
	---help---
	  This enables support for systems with more than one thread running
	  Linux. If you have a system with only one thread running Linux,
	  say N. Otherwise, say Y.

config NR_CPUS
	int "Maximum number of CPUs (2-4)" if SMP
	range 2 4 if SMP
	default "1" if !SMP
	default "4" if SMP

config SMP_WRITE_REORDERING
	bool
	---help---
	  This attempts to prevent cache-memory incoherence due to external
	  reordering of writes from different hardware threads when SMP is
	  enabled. It adds fences (system event 0) to smp_mb and smp_rmb in an
	  attempt to catch some of the cases, and also before writes to shared
	  memory in LOCK1 protected atomics and spinlocks.
	  This will not completely prevent cache incoherency on affected cores.

config LNKGET_AROUND_CACHE
	bool
	depends on META21
	---help---
	  This indicates that the LNKGET/LNKSET instructions go around the
	  cache, which requires some extra cache flushes when the memory needs
	  to be accessed by normal GET/SET instructions too.

choice
	prompt "Atomicity primitive"
	default ATOMICITY_LNKGET
	---help---
	  This option selects the mechanism for performing atomic operations.

config ATOMICITY_IRQSOFF
	depends on !SMP
	bool "irqsoff"
	---help---
	  This option disables interrupts to achieve atomicity. This mechanism
	  is not SMP-safe.

config ATOMICITY_LNKGET
	depends on META21
	bool "lnkget/lnkset"
	---help---
	  This option uses the LNKGET and LNKSET instructions to achieve
	  atomicity. LNKGET/LNKSET are load-link/store-conditional instructions.
	  Choose this option if your system requires low latency.

config ATOMICITY_LOCK1
	depends on SMP
	bool "lock1"
	---help---
	  This option uses the LOCK1 instruction for atomicity. This is mainly
	  provided as a debugging aid if the lnkget/lnkset atomicity primitive
	  isn't working properly.

endchoice

config META_FPU
	bool "FPU Support"
	depends on META21
	default y
	help
	  This option allows processes to use FPU hardware available with this
	  CPU. If this option is not enabled FPU registers will not be saved
	  and restored on context-switch.

	  If you plan on running programs which are compiled to use hard floats
	  say Y here.

config META_DSP
	bool "DSP Support"
	help
	  This option allows processes to use DSP hardware available
	  with this CPU. If this option is not enabled DSP registers
	  will not be saved and restored on context-switch.

	  If you plan on running DSP programs say Y here.

config META_PERFCOUNTER_IRQS
	bool "PerfCounters interrupt support"
	depends on META21
	help
	  This option enables using interrupts to collect information from
	  Performance Counters. This option is supported in new META21
	  (starting from HTP265).

	  When disabled, Performance Counters information will be collected
	  based on Timer Interrupt.

config METAG_DA
	bool "DA support"
	help
	  Say Y if you plan to use a DA debug adapter with Linux. The presence
	  of the DA will be detected automatically at boot, so it is safe to say
	  Y to this option even when booting without a DA.

	  This enables support for services provided by DA JTAG debug adapters,
	  such as:
	  - communication over DA channels (such as the console driver).
	  - use of the DA filesystem.

menu "Boot options"

config METAG_BUILTIN_DTB
	bool "Embed DTB in kernel image"
	default y
	help
	  Embeds a device tree binary in the kernel image.

config METAG_BUILTIN_DTB_NAME
	string "Built in DTB"
	depends on METAG_BUILTIN_DTB
	help
	  Set the name of the DTB to embed (leave blank to pick one
	  automatically based on kernel configuration).

config METAG_CMDLINE_BOOL
	bool "Built-in kernel command line"
	---help---
	  Allow for specifying boot arguments to the kernel at
	  build time.  On some systems (e.g. embedded ones), it is
	  necessary or convenient to provide some or all of the
	  kernel boot arguments with the kernel itself (that is,
	  to not rely on the boot loader to provide them.)

	  To compile command line arguments into the kernel,
	  set this option to 'Y', then fill in the
	  the boot arguments in CONFIG_METAG_CMDLINE.

	  Systems with fully functional boot loaders (i.e. non-embedded)
	  should leave this option set to 'N'.

config METAG_CMDLINE
	string "Built-in kernel command string"
	depends on METAG_CMDLINE_BOOL
	default ""
	---help---
	  Enter arguments here that should be compiled into the kernel
	  image and used at boot time.  If the boot loader provides a
	  command line at boot time, it is appended to this string to
	  form the full kernel command line, when the system boots.

	  However, you can use the CONFIG_METAG_CMDLINE_OVERRIDE option to
	  change this behavior.

	  In most cases, the command line (whether built-in or provided
	  by the boot loader) should specify the device for the root
	  file system.

config METAG_CMDLINE_OVERRIDE
	bool "Built-in command line overrides boot loader arguments"
	depends on METAG_CMDLINE_BOOL
	---help---
	  Set this option to 'Y' to have the kernel ignore the boot loader
	  command line, and use ONLY the built-in command line.

	  This is used to work around broken boot loaders.  This should
	  be set to 'N' under normal conditions.

endmenu

menu "Board support"

endmenu

source "arch/metag/kernel/cpu/Kconfig"

source "kernel/Kconfig.preempt"

source kernel/Kconfig.hz

endmenu

menu "Power management options"

source kernel/power/Kconfig

endmenu

menu "Executable file formats"

source "fs/Kconfig.binfmt"

endmenu

source "net/Kconfig"

source "drivers/Kconfig"

source "fs/Kconfig"

source "arch/metag/Kconfig.debug"

source "security/Kconfig"

source "crypto/Kconfig"

source "lib/Kconfig"
```

## arch/metag/Kconfig.soc
```kconfig
choice
	prompt "SoC Type"
	default META21_FPGA

config META12_FPGA
	bool "Meta 1.2 FPGA"
	select META12
	---help---
	  This is a Meta 1.2 FPGA bitstream, just a bare CPU.

config META21_FPGA
	bool "Meta 2.1 FPGA"
	select META21
	---help---
	  This is a Meta 2.1 FPGA bitstream, just a bare CPU.

endchoice

menu "SoC configuration"

if META21

# Meta 2.x specific options

config META21_MMU
	bool "Meta 2.x MMU mode"
	depends on META21
	default y
	help
	  Use the Meta 2.x MMU in extended mode.

config META21_UNALIGNED
	bool "Meta 2.x unaligned access checking"
	depends on META21
	default y
	help
	  All memory accesses will be checked for alignment and an exception
	  raised on unaligned accesses. This feature does cost performance
	  but without it there will be no notification of this type of error.

config META_USER_TCM
	bool "Meta on-chip memory support for userland"
	depends on META21
	select GENERIC_ALLOCATOR
	default y
	help
	  Allow the on-chip memories of Meta SoCs to be used by user
	  applications.

endif

config META_HALT_ON_PANIC
	bool "Halt the core on panic"
	help
	  Halt the core when a panic occurs. This is useful when running
	  pre-production silicon or in an FPGA environment.

endmenu
```

## arch/metag/kernel/cpu/Kconfig
```kconfig
config META_CORE_SYSFS
	bool "Meta core sysfs interface"
	select SYSFS
	help
	  This enables a sysfs driver that gives access to the CPU core
	  parameters such as cycle counters and configuration registers.

config META_WRITE_COMBINER
	bool "Meta write combiner sysfs interface"
	depends on META_CORE_SYSFS
	help
	  This enables a sysfs driver that gives access to the CPU core
	  write combiner hardware.

config META_MEM_ARBITER
	bool "Meta memory arbiter sysfs interface"
	depends on META_CORE_SYSFS
	help
	  This enables a sysfs driver that gives access to the CPU core
	  memory arbiter hardware.

config META_CYCLE_COUNTER
	bool "Meta cycle counters"
	depends on META_CORE_SYSFS
	help
	  This enables a sysfs driver that gives access to the CPU core
	  cycle counters.

config META_PERFORMANCE_COUNTER
	bool "Meta performance counters"
	depends on META_CORE_SYSFS
	help
	  This enables a sysfs driver that gives access to the CPU core
	  performance counters.

config META_AMA_COUNTER
	bool "Meta Automatic MIPs Allocation counters"
	depends on META_CORE_SYSFS
	help
	  This enables a sysfs driver that gives access to the CPU core
	  Automatic MIPs Allocation counters.

config META_L2C_CONTROL
	bool "Level 2 Cache control"
	depends on META_CORE_SYSFS && META_L2C
	help
	  This enables a sysfs driver that provides access to the CPU core level
	  2 cache configuration (information like line size, ways of
	  associativity, total size, whether unified, and the hardware revision
	  number). It also provides controls to enable and disable the L2 cache,
	  to enable and disable prefetch, and to trigger write backs and
	  flushes, mostly for debug purposes. They can be found in
	  /sys/devices/system/cache/l2/.
```

## drivers/net/ethernet/osci_lan/Kconfig
```kconfig
#
# EZchip network device configuration
#

config NET_OSCI_LAN
	tristate "OSCI LAN support"
	depends on ARC
	default n
	---help---
	  Simple LAN device without multicast support for use with the
	  nSIM OSCI System C model.
```
